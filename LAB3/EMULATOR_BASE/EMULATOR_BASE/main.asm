.ORG 0x0000
	RJMP ONRESET
.ORG 0x0002
	RJMP ISR_INT0   ;INT0 EXTERNAL INTERRUPT HANDLER
.ORG 0x0009
	RJMP ISR_TIMER0 ;TIMER0 OVERFLOW INTERRUPT HANDLER

.org 0x000E 
	RJMP ISR_ADC ;ADC OVERFLOW INTERRUPT HANDLER 
	
.include "macros.asm"

ONRESET:
	macro_setup;
	macro_timer0;
	macro_int0;
	macro_adc;		; including ADC setup macro 
	SEI
;********
;********
;********

;800 IN DECIMAL:
LDI R31, 0x01	; HIGH BYTE
LDI R30, 0xC2	; LOW BYTE


MAIN: 
	
	CBI ADCSRA,ADFR ;SINGLE CONVERSION MODE
	SBI ADCSRA,ADSC ;START CONVERSION
	
	CP R15, R31
	BREQ LOOP1
	BRLO LOOP2
	RJMP MAIN

LOOP1:  CP R14,R30
		BRLO LOOP2
		BRSH OFF_LED
        RJMP MAIN

LOOP2:  SBI PORTB, 1
        RJMP MAIN

OFF_LED: CBI PORTB, 1
         RJMP MAIN  
 

	
;********
;********
;********
.include "display_functions.asm"

ISR_INT0:
	CLI				;DISABLE GLOBAL INTERRUPT ENABLE
	IN R26, SREG	;SAVE STATUS REGISTER
	;*******
	;WRITE CODE WHAT YOU WANT TO DO WHEN INT0 INTERRUPT COMES
	;R14=0x00 R15=0x00 COUNT NUMBER START VALUES**
	;*******
	LDI	R16, 0xFF	
	MOV	R14, R16	;COUNT NUMBER LOW BYTE
	LDI	R16, 0x00
	MOV	R15, R16	;COUNT NUMBER HIGH BYTE
	;*******
	OUT	 SREG, R26		;RELOAD STATUS REGISTER
    RETI					;RETURN FROM INT0 INTERRUPT HANDLER

ISR_TIMER0:
	macro_display R14,R15;	;DISPLAY HEX NUM.R14=LOW BYTE R15=HIGH BYTE 
    RETI					;RETURN FROM TIMER0 INTERRUPT HANDLER

ISR_ADC: 
	CLI
	IN R14, ADCL 
	IN R15, ADCH 
	SBI ADCSRA,ADSC 
	RETI ;RETURN FROM ADC INTERRUPTаHANDLER