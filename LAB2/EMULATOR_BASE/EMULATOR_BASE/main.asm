.ORG 0x0000
	RJMP ONRESET
.ORG 0x0002
	RJMP ISR_INT0   ;INT0 EXTERNAL INTERRUPT HANDLER
.ORG 0x0009
	RJMP ISR_TIMER0 ;TIMER0 OVERFLOW INTERRUPT HANDLER

.include "macros.asm"

ONRESET:
	macro_setup;
	macro_timer0;
	macro_int0;
	SEI

	LDI R29, 0
	MOV R15, R29
	LDI R23, 3
    MOV R14, R23
	LDI R31, 255
	LDI R30, 0


MAIN:     
    SBIS PINB, PORTB2
    RJMP LOOP1
    SBIS PIND, PORTD2
    RJMP LOOP2    
    RJMP MAIN


LOOP1: 
	CP R30,R14
	BRSH LOOP4
	DEC R14
	RJMP SET_DEC
   

LOOP2:
	CP R14,R31
	BRSH LOOP4
	INC R14
    RJMP SET_INC

LOOP3:
	LDI R29,0x03
	RCALL DELAY_EX
	SBIC PINB, PORTB2
	RJMP MAIN
	SBIS PIND, PORTD2
	MOV R14,R29
	RJMP MAIN

LOOP4:
	MOV R14,R14
	RJMP MAIN

SET_DEC:
	SBIS PIND, PORTD2
	RJMP LOOP3
	SBIS PINB, PORTB2
	RJMP SET_DEC
	RJMP MAIN

SET_INC:
	SBIS PINB, PORTB2
	RJMP LOOP3
	SBIS PIND, PORTD2
	RJMP SET_INC
	RJMP MAIN

.include "display_functions.asm"

ISR_INT0:
	CLI				;DISABLE GLOBAL INTERRUPT ENABLE
	IN R26 , SREG	;SAVE STATUS REGISTER
	;***
	;WRITE CODE WHAT YOU WANT TO DO WHEN INT0 INTERRUPT COMES
	;R14=0x00 R15=0x00 COUNT NUMBER START VALUES**
	;***
	
	;LDI	R16 , R14	
	;MOV	R14 , R16	;COUNT NUMBER LOW BYTE

	MOV	R16 , R14
	MOV	R14 , R16	;COUNT NUMBER LOW BYTE
	LDI	R16 , 0x00
	MOV	R15 , R16	;COUNT NUMBER HIGH BYTE
	;***
	OUT	 SREG , R26		;RELOAD STATUS REGISTER
    RETI					;RETURN FROM INT0 INTERRUPT HANDLER

ISR_TIMER0:
	macro_display R14 , R15	;DISPLAY HEX NUM.R14=LOW BYTE R15=HIGH BYTE 
    RETI					;RETURN FROM TIMER0 INTERRUPTаHANDLER